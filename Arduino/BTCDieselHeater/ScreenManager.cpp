#include "ScreenManager.h"
#include <SPI.h>
#include <Wire.h>
#include "128x64OLED.h"
#include "pins.h"
#include "BluetoothAbstract.h" 
#include "Screen1.h"
#include "Screen2.h"
#include "Screen3.h"
#include "Screen4.h"
#include "Screen5.h"

//
// **** NOTE: There are two very lame libaries conspiring to make life difficult ****
// A/ The ESP32 SPI.cpp library instatiates an instance of SPI, using the VSPI port (and pins)
// B/ The Adfruit_SH1106 library has hard coded "SPI" as the SPI port instance
//
// As an ESP32 has a pin multiplexer, this is very bad form.
// The design uses the defacto HSPI pins (and port), 
// You **MUST comment out the SPIClass SPI(VSPI);**  at the end of the ESP32 SPI library
// then we declare "SPI" here, which will use HSPI!!!!

// 128 x 64 OLED support
SPIClass SPI;    // default constructor opens HSPI on standard pins : MOSI=13,CLK=14,MISO=12(unused)

////////////////////////////////////////////////////////////////////////////////////////////////
// splash creen created using image2cpp http://javl.github.io/image2cpp/
//   Settings: 
//      Black background
//      Invert [X]
//      Arduino code, single bitmap
//      Identifier: DieselSplash
//      Draw Mode: Horizontal
//
const unsigned char DieselSplash [] PROGMEM = {
	// 'Splash2, 128x64px
	0x00, 0x00, 0x00, 0x00, 0x00, 0x00, 0x00, 0x00, 0x00, 0x00, 0x00, 0x00, 0x00, 0x00, 0x00, 0x00, 
	0x00, 0x00, 0x00, 0x00, 0x00, 0x00, 0x00, 0x00, 0x00, 0x00, 0x00, 0x00, 0x00, 0x00, 0x00, 0x00, 
	0x00, 0x00, 0x00, 0x00, 0x00, 0x00, 0x00, 0x00, 0x00, 0x00, 0x00, 0x00, 0x00, 0x00, 0x00, 0x00, 
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	0x11, 0x39, 0x8e, 0x93, 0x18, 0xe1, 0x13, 0x1c, 0xcc, 0x80, 0x78, 0xc9, 0x34, 0x19, 0x4c, 0x80
};


CScreenManager::CScreenManager() 
{
  _pDisplay = NULL;
  _pActiveScreen = NULL;
  for(int i = 0; i < _maxScreens; i++)
    _pScreen[i] = NULL;
  _currentScreen = 1;
  _bReqUpdate = false;
}

CScreenManager::~CScreenManager()
{
  _pActiveScreen = NULL;      
  for(int i=0; i<_maxScreens; i++) {
    if(_pScreen[i]) {
      delete _pScreen[i]; _pScreen[i] = NULL;
    }
  }
  if(_pDisplay) {
    delete _pDisplay; _pDisplay = NULL;
  }
}

void 
CScreenManager::init()
{

  // 128 x 64 OLED support (Hardware SPI)
  // SH1106_SWITCHCAPVCC = generate display voltage from 3.3V internally
#if OLED_HW_SPI == 1
  SPI.setFrequency(8000000);
  _pDisplay = new C128x64_OLED(OLED_DC_pin, -1, OLED_CS_pin);
  _pDisplay->begin(SH1106_SWITCHCAPVCC, 0, false);
#else
  _pDisplay = new C128x64_OLED(OLED_SDA_pin, OLED_SCL_pin);
  _pDisplay->begin(SH1106_SWITCHCAPVCC);
  Wire.begin(OLED_SDA_pin, OLED_SCL_pin, 800000);   // speed up I2C from the default crappy 100kHz set via the adafruit begin!
#endif

  // replace adafruit splash screen
  _pDisplay->clearDisplay();
  _pDisplay->drawBitmap(0, 0, DieselSplash, 128, 64, WHITE);

  // Show initial display buffer contents on the screen --
  _pDisplay->display();

  _pScreen[0] = new CScreen1(*_pDisplay, *this);
  _pScreen[1] = new CScreen2(*_pDisplay, *this);
  _pScreen[2] = new CScreen3(*_pDisplay, *this);
  _pScreen[3] = new CScreen4(*_pDisplay, *this);
  _pScreen[4] = new CScreen5(*_pDisplay, *this);

  _switchScreen();
}

void 
CScreenManager::checkUpdate()
{
  if(_bReqUpdate) {
    if(_pActiveScreen) {
      _pActiveScreen->show();
      _bReqUpdate = false;
    }
  }
}
  
void 
CScreenManager::reqUpdate()
{
  _bReqUpdate = true;
}

void 
CScreenManager::animate()
{
  if(_pActiveScreen) _pActiveScreen->animate();
}

void 
CScreenManager::_switchScreen()
{
  if(_currentScreen < _maxScreens)
    _pActiveScreen = _pScreen[_currentScreen]; 
  
  //        reqDisplayUpdate();
  reqUpdate();
}

void 
CScreenManager::nextScreen()
{
  _currentScreen++;
  if(_currentScreen >= _maxScreens) {
    _currentScreen = 0;
  }
  _switchScreen();
}

void 
CScreenManager::prevScreen()
{
  _currentScreen--;
  if(_currentScreen < 0) {
    _currentScreen = _maxScreens-1;
  }
  _switchScreen();
}

void 
CScreenManager::keyHandler(uint8_t event)
{
  if(_pActiveScreen) _pActiveScreen->keyHandler(event);
}


